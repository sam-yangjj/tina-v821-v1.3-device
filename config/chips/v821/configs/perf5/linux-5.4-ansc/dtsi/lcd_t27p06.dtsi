&disp {
	disp_init_enable         = <1>;
	disp_mode                = <0>;

	screen0_output_type      = <1>;
	screen0_output_mode      = <4>;
	screen0_to_lcd_index     = <0>;

	screen1_output_type      = <3>;
	screen1_output_mode      = <10>;
	screen1_to_lcd_index     = <2>;

	screen1_output_format    = <0>;
	screen1_output_bits      = <0>;
	screen1_output_eotf      = <4>;
	screen1_output_cs        = <257>;
	screen1_output_dvi_hdmi  = <2>;
	screen1_output_range     = <2>;
	screen1_output_scan      = <0>;
	screen1_output_aspect_ratio = <8>;

	fb_format                = <0>;
	fb_num                   = <1>;
	fb_debug                 = <0>;
	/*<disp channel layer zorder>*/
	fb0_map                  = <0 0 0 16>;
	fb0_width                = <320>;
	fb0_height               = <240>;
	/*<disp channel layer zorder>*/
	fb1_map                  = <0 2 0 16>;
	fb1_width                = <300>;
	fb1_height               = <300>;
	/*<disp channel layer zorder>*/
	fb2_map                  = <1 0 0 16>;
	fb2_width                = <1280>;
	fb2_height               = <720>;
	/*<disp channel layer zorder>*/
	fb3_map                  = <1 1 0 16>;
	fb3_width                = <300>;
	fb3_height               = <300>;

	chn_cfg_mode             = <1>;
	disp_para_zone           = <1>;
};

&lcd0 {
	lcd_used            = <1>;
	lcd_driver_name     = "t27p06";

	lcd_if              = <0>;
	lcd_hv_if           = <8>;

	lcd_x               = <320>;
	lcd_y               = <240>;
	lcd_width           = <108>;
	lcd_height          = <64>;

	lcd_dclk_freq       = <27>;
	lcd_hbp             = <70>;
	lcd_ht              = <1716>;
	lcd_hspw            = <1>;
	lcd_vbp             = <21>;
	lcd_vt              = <263>;
	lcd_vspw            = <1>;

	lcd_backlight       = <255>;
	lcd_pwm_used        = <1>;
	lcd_pwm_ch          = <5>;
	lcd_pwm_freq        = <50000>;
	lcd_pwm_pol         = <0>;
	lcd_pwm_max_limit   = <255>;
	/* lcd_bl_en           = <&pio PB 1 1 0 3 1>; */
	lcd_bright_curve_en = <1>;

	lcd_frm             = <0>;
	lcd_hv_clk_phase    = <1>;
	lcd_hv_sync_polarity= <0>;
	lcd_hv_srgb_seq     = <2>;
	lcd_io_phase        = <0x0000>;
	lcd_gamma_en        = <0>;
	lcd_cmap_en         = <0>;
	lcd_rb_swap         = <0>;

	/* not ppu */
	/* lcd_power           = "vcc-lcd"; */
	/* lcd_pin_power       = "vcc-pd"; */

	/* cs */
	lcd_gpio_0          = <&pio PD 22 GPIO_ACTIVE_LOW>;
	/* sda */
	lcd_gpio_1          = <&pio PD 23 GPIO_ACTIVE_LOW>;
	/* sck */
	lcd_gpio_2          = <&pio PC 16 GPIO_ACTIVE_LOW>;

	pinctrl-0 = <&rgb8_pins_a>, <&rgb8_pins_ctl_a>;
	pinctrl-1 = <&rgb8_pins_b>, <&rgb8_pins_ctl_b>;
};